## arch/arm/mach-snapdragon/Kconfig
```kconfig
if ARCH_SNAPDRAGON

config INFINITI_RAM_DIAGNOSTIC
	bool "Local Infiniti RAM diagnostic layout"
	depends on POSITION_INDEPENDENT && !SCSI && !UFS && !MMC
	help
	  Use a zero Image text offset and explicit non-overlapping BSS
	  placement for the local LLVM-built Android RAM candidates.

config INFINITI_FDT_CHECKPOINT
	bool "Local Infiniti post-FDT reset checkpoint"
	depends on INFINITI_RAM_DIAGNOSTIC
	help
	  Immediately request a PSCI reset after U-Boot has validated its
	  initial device tree and memory map. Diagnostic only; never enable
	  in a normal boot candidate.

config INFINITI_BOARD_CHECKPOINT
	bool "Local Infiniti post-relocation board reset checkpoint"
	depends on INFINITI_RAM_DIAGNOSTIC && !INFINITI_FDT_CHECKPOINT
	help
	  Immediately request a PSCI reset from board_init(), after U-Boot
	  relocation and driver-model initialization. Diagnostic only.

config INFINITI_LATE_CHECKPOINT
	bool "Local Infiniti post-console reset checkpoint"
	depends on INFINITI_RAM_DIAGNOSTIC && !INFINITI_FDT_CHECKPOINT && !INFINITI_BOARD_CHECKPOINT
	help
	  Immediately request a PSCI reset after U-Boot console, environment,
	  LMB, and board-late initialization. Diagnostic only.

config INFINITI_RAM_PAYLOAD
	bool "Embedded Infiniti diagnostic Linux payload (experimental)"
	depends on !SCSI && !UFS && !MMC && !EFI_LOADER
	help
	  Local experimental RAM-only handoff. Build with generated payload
	  filenames. No storage fallback. Not validated on physical hardware.

config SYS_SOC
	default "snapdragon"

config SYS_VENDOR
	string "Snapdragon board vendor"
	default "qualcomm"
	help
	  Allows to specify vendor for the Snapdragon SoCs based boards.
	  Based on this option board/<CONFIG_SYS_VENDOR>/<CONFIG_SYS_BOARD>
	  will be used as the custom board directory.

config SYS_MALLOC_LEN
	default 0x10000000

config SYS_MALLOC_F_LEN
	default 0x2000

config SPL_SYS_MALLOC_F_LEN
	default 0x2000

config SYS_MALLOC_LEN
	default 0x800000

config LNX_KRNL_IMG_TEXT_OFFSET_BASE
	default TEXT_BASE if INFINITI_RAM_DIAGNOSTIC
	default 0x80000000

config SYS_BOARD
	string "Snapdragon SoCs based board"
	help
	  Allows to specify the Snapdragon SoCs based board name.
	  Based on this option board/<CONFIG_SYS_VENDOR>/<CONFIG_SYS_BOARD>
	  will be used as the custom board directory.

config SYS_CONFIG_NAME
	string "Board configuration name"
	default SYS_BOARD if SYS_BOARD != ""
	default "qcom"
	help
	  This option contains information about board configuration name.
	  Based on this option include/configs/<CONFIG_SYS_CONFIG_NAME>.h header
	  will be used for board configuration.

endif
```
